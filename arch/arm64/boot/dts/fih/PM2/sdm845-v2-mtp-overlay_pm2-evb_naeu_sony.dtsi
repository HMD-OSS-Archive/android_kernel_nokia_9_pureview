#include "sdm845-fih-info_pm2-evb_naeu_sony.dtsi"

/* Pinctrl */
#include "sdm845-pinctrl_pm2-evb.dtsi"
#include "pm845-pinctrl_pm2-evb.dtsi"
#include "pmi8998-pinctrl_pm2-evb.dtsi"
#include "pm8005-pinctrl_pm2-evb.dtsi"

#include "sdm845-platform_pm2-evb.dtsi"
#include "sdm845-pmic_pm2-evb.dtsi"

/* LED */
#include "led_lp5562.dtsi"

/* camera */
#include "sdm845-pm2-camera.dtsi"

/* NFC */
#include "nfc-sony-nci.dtsi"

/* Haptic */
#include "dw7912_hatpics.dtsi"

/* display */
#include "sdm845-pm2-display.dtsi"

/* Audio */
#include "audio_pm2-evb.dtsi"

/* sibeam */
#include "sdm845-pm2-sibeam.dtsi"
