&qupv3_se3_i2c{
	status = "ok";
	nq@28 {
		status = "disabled";
	};
	sony_cxd224x@28 {
		compatible = "sony,cxd224x-i2c";
		status = "ok";
		reg = <0x28>;
		clock-frequency = <400000>;
		sony,nfc_int = <&tlmm 63 0x00>;
		sony,nfc_rst = <&tlmm 62 0x00>;
		sony,nfc_wake = <&tlmm 12 0x00>;
		sony,nfc_ven = <&tlmm 92 0x00>;
		interrupt-parent = <&tlmm>;
		interrupts = <63 2>;  /*1 = low-to-high edge triggered
					2 = high-to-low edge triggered
					4 = active high level-sensitive
					8 = active low level-sensitive */
		interrupt-names = "nfc_irq";
	};
};
