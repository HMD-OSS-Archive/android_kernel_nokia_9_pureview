&soc {
	fih_info {
		compatible = "fih_info";
		status = "ok";
		fih-info,devmodel = "PM2";
		fih-info,baseband = "2.1J";
		fih-info,bandinfo = "G_850_900_1800_1900^W_1_2_3_4_5_8^L_1_2_3_4_5_7_8_11_13_17_18_19_20_21_25_26_28_38_39_40_41_66";
		fih-info,hwmodel  = "PM2";
		fih-info,simslot  = "2";
	};
};
