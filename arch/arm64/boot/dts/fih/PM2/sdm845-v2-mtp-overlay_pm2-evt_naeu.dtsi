#include "sdm845-fih-info_pm2-evt_naeu.dtsi"

/* Pinctrl */
#include "sdm845-pinctrl_pm2-evt.dtsi"
#include "pm845-pinctrl_pm2-evt.dtsi"
#include "pmi8998-pinctrl_pm2-evt.dtsi"
#include "pm8005-pinctrl_pm2-evt.dtsi"

#include "sdm845-platform_pm2-evt.dtsi"
#include "sdm845-pmic_pm2-evt.dtsi"

/* LED */
#include "led_lp5562.dtsi"

/* camera */
#include "sdm845-pm2-camera.dtsi"

/* NFC */
#include "nfc-sony-nci.dtsi"

/* Haptic */
#include "dw7912_hatpics.dtsi"

/* Audio */
#include "audio_pm2-evb.dtsi"

